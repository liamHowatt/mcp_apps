## CustomHello/Kconfig
```kconfig
#
# For a description of the syntax of this configuration file,
# see the file kconfig-language.txt in the NuttX tools repository.
#

config MCP_APPS_CUSTOM_HELLO
        tristate "Custom Hello App"
        default n
        ---help---
                Enable the Custom Hello App

if MCP_APPS_CUSTOM_HELLO

config MCP_APPS_CUSTOM_HELLO_PROGNAME
        string "Program name"
        default "custom_hello"
        ---help---
                This is the name of the program that will be used when the NSH ELF
                program is installed.

config MCP_APPS_CUSTOM_HELLO_PRIORITY
        int "Custom Hello task priority"
        default 100

config MCP_APPS_CUSTOM_HELLO_STACKSIZE
        int "Custom Hello stack size"
        default DEFAULT_TASK_STACKSIZE

endif
```

## beeper/Kconfig
```kconfig
#
# For a description of the syntax of this configuration file,
# see the file kconfig-language.txt in the NuttX tools repository.
#

config MCP_APPS_BEEPER
        tristate "Beeper App"
        default n
        depends on GRAPHICS_LVGL && HAVE_CXX && UCLIBCXX && CRYPTO_WOLFSSL && MCP_APPS_TEXTER_UI && EVENT_FD
        ---help---
                Enable the Beeper App

if MCP_APPS_BEEPER

config MCP_APPS_BEEPER_APPDATA_PATH
        string "Persisted data path"
        default "/data"
        ---help---
                Path to persistent login credientials and cryptography state.
                A sub directory called beeper will automatically be created there.

config MCP_APPS_BEEPER_NETWORKING_THREAD_STACKSIZE
        int "Beeper networking thread stack size"
        default PTHREAD_STACK_DEFAULT

endif
```

## mcp_daemon/Kconfig
```kconfig
#
# For a description of the syntax of this configuration file,
# see the file kconfig-language.txt in the NuttX tools repository.
#

config MCP_APPS_MCP_DAEMON
        tristate "MCP Daemon App"
        default n
        ---help---
                Enable the MCP Daemon App

if MCP_APPS_MCP_DAEMON

config MCP_APPS_MCP_DAEMON_PROGNAME
        string "Program name"
        default "mcp_daemon"
        ---help---
                This is the name of the program that will be used when the NSH ELF
                program is installed.

config MCP_APPS_MCP_DAEMON_PRIORITY
        int "MCP Daemon task priority"
        default 100

config MCP_APPS_MCP_DAEMON_STACKSIZE
        int "MCP Daemon stack size"
        default DEFAULT_TASK_STACKSIZE

endif
```

## mcp_forth/Kconfig
```kconfig
#
# For a description of the syntax of this configuration file,
# see the file kconfig-language.txt in the NuttX tools repository.
#

config MCP_APPS_MCP_FORTH
        tristate "MCP Forth App"
        default n
        depends on FS_NAMED_SEMAPHORES && FS_TMPFS
        ---help---
                Enable the MCP Forth App

if MCP_APPS_MCP_FORTH

config MCP_APPS_MCP_FORTH_MAX_CALLBACKS
        int "max created C callbacks"
        default 8

config MCP_APPS_MCP_FORTH_SAMPLES_ROMFS
        bool "include sample programs romfs"
        default n
        depends on BUILD_FLAT && BOARDCTL_ROMDISK

if MCP_APPS_MCP_FORTH_SAMPLES_ROMFS
        config MCP_APPS_MCP_FORTH_SAMPLES_ROMFS_MINOR_NO
                int "minor number of the romfs block device"
                default 0
endif

choice MCP_APPS_MCP_FORTH_NATIVE
        prompt "Native machine code emitter to use"
        default MCP_APPS_MCP_FORTH_NATIVE_NONE

        config MCP_APPS_MCP_FORTH_NATIVE_NONE
                bool "bytecode VM only"
        config MCP_APPS_MCP_FORTH_NATIVE_X86_32
                bool "x86-32"
        config MCP_APPS_MCP_FORTH_NATIVE_ESP32S3
                bool "ESP32-S3"
endchoice

config MCP_APPS_MCP_FORTH_PROGNAME
        string "Program name"
        default "mcp_forth"
        ---help---
                This is the name of the program that will be used when the NSH ELF
                program is installed.

config MCP_APPS_MCP_FORTH_PRIORITY
        int "MCP Forth task priority"
        default 100

config MCP_APPS_MCP_FORTH_STACKSIZE
        int "MCP Forth stack size"
        default DEFAULT_TASK_STACKSIZE

endif
```

## mcp_fs/Kconfig
```kconfig
#
# For a description of the syntax of this configuration file,
# see the file kconfig-language.txt in the NuttX tools repository.
#

config MCP_APPS_MCP_FS
        tristate "MCP FS App"
        default n
        depends on NET_LOCAL && MCP_APPS_MCP_DAEMON && FS_USERFS && NET_LOOPBACK_PKTSIZE >= 16384 && SCHED_LPWORK
        ---help---
                Enable the MCP FS App

if MCP_APPS_MCP_FS

config MCP_APPS_MCP_FS_PROGNAME
        string "Program name"
        default "mcp_fs"
        ---help---
                This is the name of the program that will be used when the NSH ELF
                program is installed.

config MCP_APPS_MCP_FS_PRIORITY
        int "MCP FS task priority"
        default 100

config MCP_APPS_MCP_FS_STACKSIZE
        int "MCP FS stack size"
        default DEFAULT_TASK_STACKSIZE

endif
```

## mcp_init/Kconfig
```kconfig
#
# For a description of the syntax of this configuration file,
# see the file kconfig-language.txt in the NuttX tools repository.
#

config MCP_APPS_MCP_INIT
        tristate "MCP Init App"
        default n
        depends on LIBC_EXECFUNCS
        ---help---
                Enable the MCP Init App

if MCP_APPS_MCP_INIT

config MCP_APPS_MCP_INIT_PROGNAME
        string "Program name"
        default "mcp_init"
        ---help---
                This is the name of the program that will be used when the NSH ELF
                program is installed.

config MCP_APPS_MCP_INIT_PRIORITY
        int "MCP Init task priority"
        default 100

config MCP_APPS_MCP_INIT_STACKSIZE
        int "MCP Init stack size"
        default DEFAULT_TASK_STACKSIZE

endif
```

## mcp_lvgl/Kconfig
```kconfig
#
# For a description of the syntax of this configuration file,
# see the file kconfig-language.txt in the NuttX tools repository.
#

config MCP_APPS_MCP_LVGL
        tristate "MCP LVGL App"
        default n
        depends on GRAPHICS_LVGL && MCP_APPS_MCP_FORTH && MCP_APPS_MCP_FS
        ---help---
                Enable the MCP LVGL App

if MCP_APPS_MCP_LVGL

config MCP_APPS_MCP_LVGL_PROGNAME
        string "Program name"
        default "mcp_lvgl"
        ---help---
                This is the name of the program that will be used when the NSH ELF
                program is installed.

config MCP_APPS_MCP_LVGL_PRIORITY
        int "MCP LVGL task priority"
        default 100

config MCP_APPS_MCP_LVGL_STACKSIZE
        int "MCP LVGL stack size"
        default 32768

config MCP_APPS_MCP_LVGL_STATIC_FB_STATIC
        bool "the static framebuffer is really static"
        default n

config MCP_APPS_MCP_LVGL_STATIC_FB_SIZE
        int "static framebuffer size"
        default 153600
        ---help---
                if MCP_APPS_MCP_LVGL_STATIC_FB_STATIC is disabled,
                this value will still be used as the default
                size of dynamically allocated framebuffers

config MCP_APPS_MCP_LVGL_STATIC_STACK_THREAD_STACKSIZE
        int "Use statically allocated stack memory for LVGL"
        default 0
        ---help---
                Set to 0 to disable.
                You will want to reduce MCP_APPS_MCP_LVGL_STACKSIZE
                if this option is enabled.

endif
```

## mcp_lvgl_common/Kconfig
```kconfig
#
# For a description of the syntax of this configuration file,
# see the file kconfig-language.txt in the NuttX tools repository.
#

config MCP_APPS_MCP_LVGL_COMMON
        tristate "MCP LVGL Common"
        default n
        ---help---
                Enable MCP LVGL Common

if MCP_APPS_MCP_LVGL_COMMON
endif
```

## mcpd/Kconfig
```kconfig
#
# For a description of the syntax of this configuration file,
# see the file kconfig-language.txt in the NuttX tools repository.
#

config MCP_APPS_MCPD
        tristate "MCP Daemon App"
        default n
        depends on SIGNAL_FD && NET_LOCAL
        ---help---
                Enable the MCP Daemon App

if MCP_APPS_MCPD

config MCP_APPS_MCPD_PROGNAME
        string "Program name"
        default "mcpd"
        ---help---
                This is the name of the program that will be used when the NSH ELF
                program is installed.

config MCP_APPS_MCPD_PRIORITY
        int "MCP Daemon task priority"
        default 100

config MCP_APPS_MCPD_STACKSIZE
        int "MCP Daemon stack size"
        default DEFAULT_TASK_STACKSIZE

endif
```

## peanut_gb/Kconfig
```kconfig
#
# For a description of the syntax of this configuration file,
# see the file kconfig-language.txt in the NuttX tools repository.
#

config MCP_APPS_PEANUT_GB
        tristate "peanut_gb App"
        default n
        depends on GRAPHICS_LVGL
        ---help---
                Enable the peanut_gb App

if MCP_APPS_PEANUT_GB
endif
```

## sim_lvgl/Kconfig
```kconfig
#
# For a description of the syntax of this configuration file,
# see the file kconfig-language.txt in the NuttX tools repository.
#

menuconfig MCP_APPS_SIM_LVGL
	tristate "sim_lvgl"
	default n
	depends on GRAPHICS_LVGL
	---help---
		Enable build the Light and Versatile Graphics Library Demo programs

if MCP_APPS_SIM_LVGL

config MCP_APPS_SIM_LVGL_PRIORITY
	int "sim_lvgl task priority"
	default 100

config MCP_APPS_SIM_LVGL_STACKSIZE
	int "sim_lvgl stack size"
	default 16384

config MCP_APPS_SIM_LVGL_INPUT_DEVPATH
	string "Touchscreen device path"
	default "/dev/input0"
	depends on INPUT_TOUCHSCREEN
	---help---
		The path to the touchscreen device. Default: "/dev/input0"

endif # MCP_APPS_SIM_LVGL
```

## texter_ui/Kconfig
```kconfig
#
# For a description of the syntax of this configuration file,
# see the file kconfig-language.txt in the NuttX tools repository.
#

config MCP_APPS_TEXTER_UI
        tristate "Texter UI Component"
        default n
        depends on GRAPHICS_LVGL
        ---help---
                Enable the Texter UI Component

if MCP_APPS_TEXTER_UI

config MCP_APPS_TEXTER_UI_DEMO
        tristate "Texter UI Demo App"
        default n
        ---help---
                Enable the Texter UI Demo App

endif
```
